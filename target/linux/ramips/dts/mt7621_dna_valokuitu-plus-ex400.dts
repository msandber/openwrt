// SPDX-License-Identifier: GPL-2.0-or-later OR MIT

#include "mt7621_dna_valokuitu-plus-ex400.dtsi"

/ {
	compatible = "dna,valokuitu-plus-ex400", "mediatek,mt7621-soc";
	model = "DNA Valokuitu Plus EX400";
};
